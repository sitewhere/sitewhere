<table id="users">
	<colgroup>
		<col style="width: 14%;" />
		<col style="width: 14%;" />
		<col style="width: 14%;" />
		<col style="width: 10%;" />
		<col style="width: 14%;" />
		<col style="width: 14%;" />
		<col style="width: 14%;" />
		<col style="width: 6%;" />
	</colgroup>
	<thead>
		<tr>
			<th data-i18n="users.list.UserName"></th>
			<th data-i18n="public.FirstName"></th>
			<th data-i18n="public.LastName"></th>
			<th data-i18n="public.Status"></th>
			<th data-i18n="users.list.LastLogin"></th>
			<th data-i18n="public.Created"></th>
			<th data-i18n="public.Updated"></th>
			<th></th>
		</tr>
	</thead>
	<tbody>
		<tr>
			<td colspan="8"></td>
		</tr>
	</tbody>
</table>
<div id="pager" class="k-pager-wrap" style="margin-top: 10px;"></div>
